## firmware/boards/arm/nape_pro/Kconfig.board
```kconfig
config BOARD_NAPE_PRO
    bool "Keychron Nape Pro maintenance"
    depends on SOC_SERIES_RTL87X2G
    select SOC_PART_NUMBER_RTL8762GKU
```

## firmware/boards/arm/nape_pro/nape_pro_defconfig
```kconfig
CONFIG_SOC_SERIES_RTL87X2G=y
CONFIG_SOC_RTL8762GKU=y
CONFIG_BOARD_NAPE_PRO=y
CONFIG_FPU=y
CONFIG_TRUSTED_EXECUTION_SECURE=y
CONFIG_ARM_SECURE_BUSFAULT_HARDFAULT_NMI=y
CONFIG_XIP=y
CONFIG_CODE_DATA_RELOCATION=y
CONFIG_LINKER_USE_BOOT_SECTION=y
CONFIG_USE_DT_CODE_PARTITION=y
CONFIG_TICKLESS_KERNEL=n
CONFIG_SPEED_OPTIMIZATIONS=y
CONFIG_REALTEK_USING_SDK_LIB=y
```
